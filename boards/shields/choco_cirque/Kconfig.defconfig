## boards/shields/choco_cirque/Kconfig.defconfig
```kconfig
if SHIELD_CHOCO_CIRQUE_LEFT

config ZMK_KEYBOARD_NAME
    default "Chocofi"

config ZMK_SPLIT_ROLE_CENTRAL
    default y

endif

if SHIELD_CHOCO_CIRQUE_RIGHT

# Assuming pointing device uses SPI
config SPI
    default y

endif

if SHIELD_CHOCO_CIRQUE_LEFT || SHIELD_CHOCO_CIRQUE_RIGHT

config ZMK_SPLIT
    default y

config ZMK_POINTING
    default y

if ZMK_DISPLAY

config I2C
    default y

config SSD1306
    default y

endif # ZMK_DISPLAY

if LVGL

config LV_Z_VDB_SIZE
    default 64

config LV_DPI_DEF
    default 148

config LV_Z_BITS_PER_PIXEL
    default 1

choice LV_COLOR_DEPTH
    default LV_COLOR_DEPTH_1
endchoice

endif # LVGL

endif
```

## boards/shields/choco_cirque/Kconfig.shield
```kconfig
# Copyright (c) 2020 Pete Johanson
# SPDX-License-Identifier: MIT

config SHIELD_CHOCO_CIRQUE_LEFT
    def_bool $(shields_list_contains,choco_cirque_left)

config SHIELD_CHOCO_CIRQUE_RIGHT
    def_bool $(shields_list_contains,choco_cirque_right)
```
