    macros {
        // Powerpoint Format Painter
        ppt_fp: ppt_fp {    
            compatible = "zmk,behavior-macro";
            #binding-cells = <0>;
            bindings = <&kp LALT &kp H &kp F &kp P>;
        };
        // ^^
        wink: wink {   
            compatible = "zmk,behavior-macro";
            #binding-cells = <0>;
            bindings = <&kp CARET &kp CARET>; 
        };
    };
