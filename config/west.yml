## config/west.yml
```yaml
manifest:
  remotes:
    - name: zmkfirmware
      url-base: https://github.com/zmkfirmware
    - name: urob
      url-base: https://github.com/urob
    # - name: dhruvinsh
    #   url-base: https://github.com/dhruvinsh
    - name: petejohanson
      url-base: https://github.com/petejohanson
  projects:
    - name: zmk
      remote: zmkfirmware
      revision: v0.3
      import: app/west.yml
    - name: zmk-helpers
      remote: urob
      revision: v0.3
    - name: zmk-unicode
      remote: urob
      revision: v0.3
    - name: zmk-adaptive-key
      remote: urob
      revision: v0.3
    - name: zmk-auto-layer
      remote: urob
      revision: v0.3
    - name: zmk-tri-state
      remote: urob
      revision: v0.3
    - name: cirque-input-module
      remote: petejohanson
      revision: main
  self:
    path: config
```
