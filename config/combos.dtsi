 combos {
        compatible = "zmk,combos";

        // -- Combos for switching unicode between Windows and Linux. Added to functional layer
        /*
        tog_lin {
            bindings = <&uc UC_SET_LINUX>;
            key-positions = <LT3 RT3>;
            layers = <BASE QWE>;
        };
        tog_win {
            bindings = <&uc UC_SET_WIN_COMPOSE>;
            key-positions = <LT2 RT2>;
            layers = <BASE QWE>;
        };
        */
    };
